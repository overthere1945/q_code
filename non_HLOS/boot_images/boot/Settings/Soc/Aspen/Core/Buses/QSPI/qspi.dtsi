/**

This is the settings file for qspi

Copyright (c) Qualcomm Technologies, Inc.
All Rights Reserved.
Confidential and Proprietary - Qualcomm Technologies, Inc.
*/

#include "qspi_defines.h"

&soc {
  quadspi@22560000{

    compatible = "qcom,qspi-controller";
    reg = <0x22560000 0x400>;

    clk_encoding                = <QSPI_CLK>;
    cs_0_encoding               = <QSPI_CS_0>;
    cs_1_encoding               = <QSPI_CS_1>;

    data_0_encoding             = <QSPI_DATA_0>;
    data_1_encoding             = <QSPI_DATA_1>;
    data_2_encoding             = <QSPI_DATA_2>;
    data_3_encoding             = <QSPI_DATA_3>;

    /* Commenting as currently no tlmm configuration required for qspi.

    pinctrl-names               = "qspi-default";
    pinctrl-0                   = <&qspi_pinctrl_active>;

    */   

    se_clock                    = "gcc_qspi_cnoc_periph_ahb_clk";
    core_clock                  = "gcc_qspi_core_clk";
  };
};
