## non_HLOS/wm_proc/productsw/config/Kconfig
```kconfig
# ------------------------------------------------------------------------------
#  Copyright (c) Qualcomm Technologies, Inc.
#  All rights reserved.
#  Confidential and Proprietary - Qualcomm Technologies, Inc.
# ------------------------------------------------------------------------------

orsource "../*/config/Kconfig"
```

## non_HLOS/wm_proc/productsw/utility_glink/config/Kconfig
```kconfig
# ==============================================================================
#                 Copyright (c) 2025 Qualcomm Technologies, Inc.
#                                All Rights Reserved.
#                 Confidential and Proprietary - Qualcomm Technologies, Inc.
# ==============================================================================
# $QTI_LICENSE_C$

config QC_PDTSW_UTILITY_GLINK_ENABLE
    bool "Enable pdtsw utility glink module"
    depends on PDTSW_COMMON_WORKER_THREAD_ENABLE
    default n
    help
        Enables the product software utility glink channels.
        It would be enabled automatically if modules dependent
        on it are enabled (for ex - QC_PDTSW_PSRAM_ARBITER_ENABLE).
        It shouldn't be explicity defined in the .conf file.

config QC_PDTSW_UTILITY_GLINK_LOG_LEVEL
    int "Set log level for pdtsw utility glink module"
    range 0 4
    default 3
    help
        Level-0: OFF
        Level-1: LOG_LEVEL_ERR
        Level-2: LOG_LEVEL_WRN
        Level-3: LOG_LEVEL_INF
        Level-4: LOG_LEVEL_DBG
```

## non_HLOS/wm_proc/zephyr/kernel/config/dts/bindings/hwio/qcom,hwio.yaml
```yaml
description: qualcomm hwio

compatible: "qcom,hwio"

include: [base.yaml]

properties:

    domain_name:
      type: string
      required: true

    reg:
      required: false

    reg-names:
      required: false
```

## non_HLOS/wm_proc/zephyr/kernel/config/dts/bindings/mm/qcom,ext-addr-trans.yaml
```yaml
# Copyright (c) Qualcomm Technologies, Inc.
# 3rd party file marking retained below for attribution purposes:
# SPDX-License-Identifier: (BSD-2-Clause)
%YAML 1.2
---

description: |
   External address translations.

compatible: qcom,ext-addr-trans
```

## non_HLOS/wm_proc/zephyr/kernel/config/dts/bindings/mm/qcom,ext-trans-memory.yaml
```yaml
# Copyright (c) Qualcomm Technologies, Inc.
# 3rd party file marking retained below for attribution purposes:
# SPDX-License-Identifier: (BSD-2-Clause)
%YAML 1.2
---

description: |
   A memory block whose address is translated externally.
   
compatible: qcom,ext-trans-memory

properties:
# A dictionary of DT properties for this binding schema

  reg:
    type: array
    required: true

  external-address:
    description: The external address for this translated memory.
    type: int
    required: true
```

## non_HLOS/wm_proc/zephyr/kernel/config/dts/bindings/mm/qcom,rvcp-remapper-v3.yaml
```yaml
# Copyright (c) Qualcomm Technologies, Inc.
# 3rd party file marking retained below for attribution purposes:
# SPDX-License-Identifier: (BSD-2-Clause)
%YAML 1.2
---

description: |
   A hardware memory remapper in the RVCPv3.
   
compatible: qcom,rvcp-remapper-v3

include: ["qcom,rvcp-remapper.yaml"]
```

## non_HLOS/wm_proc/zephyr/kernel/config/dts/bindings/mm/qcom,rvcp-remapper.yaml
```yaml
# Copyright (c) Qualcomm Technologies, Inc.
# 3rd party file marking retained below for attribution purposes:
# SPDX-License-Identifier: (BSD-2-Clause)
%YAML 1.2
---

description: |
   A hardware memory remapper in the RVCP.
   
compatible: qcom,rvcp-remapper

properties:

  reg:
    type: array
    required: true

  memory-region:
    description: The local address and size of the remapped memory region.
    type: array
    required: true
```

## non_HLOS/wm_proc/zephyr/kernel/drivers/mm/Kconfig
```kconfig
# ------------------------------------------------------------------------------
#  Copyright (c) Qualcomm Technologies, Inc.
#  All rights reserved.
#  Confidential and Proprietary - Qualcomm Technologies, Inc.
# ------------------------------------------------------------------------------

menu "Qualcomm Memory Management drivers"

config QC_MM_EAT
    bool "Qualcomm memory management EAT (external address translation) module"
    depends on EXTERNAL_ADDRESS_TRANSLATION
    help
      Enables external address translation support for mapping between local
      and external physical memory regions.

config QC_MM_EAT_MAX_REGIONS
    int "Maximum number of dynamic external address translation regions"
    depends on QC_MM_EAT
    default 0 if !DT_HAS_QCOM_RVCP_REMAPPER_ENABLED && !DT_HAS_QCOM_RVCP_REMAPPER_V3_ENABLED
    default 8 if DT_HAS_QCOM_RVCP_REMAPPER_ENABLED && !DT_HAS_QCOM_RVCP_REMAPPER_V3_ENABLED
    default 24 if DT_HAS_QCOM_RVCP_REMAPPER_V3_ENABLED
    help
      Sets the maximum number of dynamic external address translation regions for
      the Qualcomm memory management EAT module.

endmenu
```

## non_HLOS/wm_proc/zephyr/kernel/libstd/Kconfig
```kconfig
#---------------------------------------------------------------------------
# Copyright (c) Qualcomm Technologies, Inc.
# All Rights Reserved.
# Confidential and Proprietary - Qualcomm Technologies, Inc.
#---------------------------------------------------------------------------

# LIBSTD configuration options

menu "QC LIBSTD"

config QC_LIBSTD
	bool
	default y
	prompt ""
	help
	  Enables standard library definitions for string functions, safe memory copy or set operations etc.
	  Applications with their in-built string and memory operations library can disable this configuraiton. 
	  By default it will be enabled for all applications.

endmenu
```
